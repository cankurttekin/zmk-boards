## boards/shields/skeletyl/Kconfig.defconfig
```kconfig
if SHIELD_SKELETYL_LEFT

config ZMK_KEYBOARD_NAME
    default "Skeletyl"

config ZMK_BATTERY_REPORTING
    default y

config ZMK_BATTERY_REPORT_INTERVAL
    default 60

config ZMK_SPLIT_ROLE_CENTRAL
    default y

config ZMK_SPLIT_BLE_CENTRAL_BATTERY_LEVEL_FETCHING
    default y

config ZMK_SPLIT_BLE_CENTRAL_BATTERY_LEVEL_PROXY
    default y

endif

if SHIELD_SKELETYL_LEFT || SHIELD_SKELETYL_RIGHT

config ZMK_SPLIT
    default y

endif
```
